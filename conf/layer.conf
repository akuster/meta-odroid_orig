## conf/layer.conf
```bitbake
# We have a conf and classes directory, add to BBPATH
BBPATH .= ":${LAYERDIR}"

# We have a recipes-* directories, add to BBFILES
BBFILES += "${LAYERDIR}/recipes-*/*/*.bb \
	${LAYERDIR}/recipes-*/*/*.bbappend"

BBFILE_COLLECTIONS += "odroid"
BBFILE_PATTERN_odroid = "^${LAYERDIR}/"
BBFILE_PRIORITY_odroid = "6"
```

## conf/machine/odroid-ux3.conf
```bitbake
#@TYPE: Machine
#@NAME: odroid-ux3

#@DESCRIPTION: Machine configuration for odroid-ux3 systems

#with-fpu=vrfv3-d16
#with=thumb
#arch=armv7
#float hard

#DEFAULTTUNE = "cortexa9hf-neon"
#DEFAULTTUNE = "cortexa15thf-neon"
DEFAULTTUNE = "cortexa15hf-neon"
#include conf/machine/include/tune-cortexa7.inc
include conf/machine/include/tune-cortexa15.inc

PREFERRED_PROVIDER_virtual/xserver ?= "xserver-xorg"
XSERVER ?= "xserver-xorg \
           xf86-input-evdev \
           xf86-input-mouse \
           xf86-video-fbdev \
           xf86-input-keyboard"

MACHINE_EXTRA_RRECOMMENDS = " kernel-modules kernel-devicetree"

EXTRA_IMAGEDEPENDS += "u-boot-odroidux3"

IMAGE_FSTYPES += "cpio.gz tar.bz2 ext4"

SERIAL_CONSOLE = "115200 ttySAC2"

PREFERRED_PROVIDER_virtual/kernel ?= "linux-odroid"
PREFERRED_VERSION_linux-odroid = "3.10%"

#specify u-boot parameters
PREFERRED_PROVIDER_virtual/bootloader = "u-boot-odroidux3"
PREFERRED_PROVIDER_u-boot = "u-boot-odroidux3"
PREFERRED_VERSION_u-boot-odroidux3 = "2012.07"

KERNEL_IMAGETYPE = "zImage"
KERNEL_DEVICETREE = "exynos5422-odroidxu3.dtb"
#KERNEL_EXTRA_ARGS += "LOADADDR=${UBOOT_ENTRYPOINT}"

UBOOT_MACHINE = "odroid_config"
#UBOOT_ENTRYPOINT = "0"
#UBOOT_LOADADDRESS = "0"

#MACHINE_FEATURES = "serial usbgadget usbhost vfat alsa screen"
```
